
#include <mpu6050_dmp.h>

#include <Arduino.h>
#include <algorithm>

 
/*=================================================================================================*/
 
/*                                    Initialize data                                              */
 
/*=================================================================================================*/


static const unsigned char dmpMemory[MPU6050_DMP_CODE_SIZE] PROGMEM = {
	/* bank # 0 */
	0xFB, 0x00, 0x00, 0x3E, 0x00, 0x0B, 0x00, 0x36, 0x00, 0x01, 0x00, 0x02, 0x00, 0x03, 0x00, 0x00,
	0x00, 0x65, 0x00, 0x54, 0xFF, 0xEF, 0x00, 0x00, 0xFA, 0x80, 0x00, 0x0B, 0x12, 0x82, 0x00, 0x01,
	0x00, 0x02, 0x00, 0x00, 0x00, 0x00, 0x00, 0x00, 0x00, 0x00, 0x00, 0x00, 0x00, 0x00, 0x00, 0x00,
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	0xFF, 0xE6, 0x80, 0x79, 0x02, 0x00, 0x00, 0x00, 0x00, 0x00, 0xD0, 0xD6, 0x00, 0x00, 0x27, 0x10,
	/* bank # 1 */
	0xFB, 0x00, 0x00, 0x00, 0x40, 0x00, 0x00, 0x00, 0x00, 0x00, 0x00, 0x00, 0x00, 0x00, 0x00, 0x00,
	0x00, 0x00, 0x00, 0x01, 0x00, 0x00, 0x00, 0x00, 0x00, 0x00, 0x01, 0x00, 0x01, 0x00, 0x00, 0x00,
	0x00, 0x00, 0xFA, 0x36, 0xFF, 0xBC, 0x30, 0x8E, 0x00, 0x05, 0xFB, 0xF0, 0xFF, 0xD9, 0x5B, 0xC8,
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	0x00, 0x00, 0x25, 0x4D, 0x00, 0x2F, 0x70, 0x6D, 0x00, 0x00, 0x05, 0xAE, 0x00, 0x0C, 0x02, 0xD0,
	/* bank # 2 */
	0x00, 0x00, 0x00, 0x00, 0x00, 0x65, 0x00, 0x54, 0xFF, 0xEF, 0x00, 0x00, 0x00, 0x00, 0x00, 0x00,
	0x00, 0x00, 0x01, 0x00, 0x00, 0x44, 0x00, 0x01, 0x00, 0x05, 0x8B, 0xC1, 0x00, 0x00, 0x01, 0x00,
	0x00, 0x00, 0x00, 0x00, 0x00, 0x65, 0x00, 0x00, 0x00, 0x54, 0x00, 0x00, 0xFF, 0xEF, 0x00, 0x00,
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	0x00, 0x00, 0x00, 0x00, 0x00, 0x00, 0x00, 0x00, 0x00, 0x00, 0x00, 0x00, 0x00, 0x00, 0x00, 0x00,
	/* bank # 3 */
	0xD8, 0xDC, 0xBA, 0xA2, 0xF1, 0xDE, 0xB2, 0xB8, 0xB4, 0xA8, 0x81, 0x91, 0xF7, 0x4A, 0x90, 0x7F,
	0x91, 0x6A, 0xF3, 0xF9, 0xDB, 0xA8, 0xF9, 0xB0, 0xBA, 0xA0, 0x80, 0xF2, 0xCE, 0x81, 0xF3, 0xC2,
	0xF1, 0xC1, 0xF2, 0xC3, 0xF3, 0xCC, 0xA2, 0xB2, 0x80, 0xF1, 0xC6, 0xD8, 0x80, 0xBA, 0xA7, 0xDF,
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	0xB8, 0xA2, 0xDF, 0xDF, 0xDF, 0xA3, 0xDF, 0xDF, 0xDF, 0xD8, 0xD8, 0xF1, 0xB8, 0xA8, 0xB2, 0x86,
	/* bank # 4 */
	0xB4, 0x98, 0x0D, 0x35, 0x5D, 0xB8, 0xAA, 0x98, 0xB0, 0x87, 0x2D, 0x35, 0x3D, 0xB2, 0xB6, 0xBA,
	0xAF, 0x8C, 0x96, 0x19, 0x8F, 0x9F, 0xA7, 0x0E, 0x16, 0x1E, 0xB4, 0x9A, 0xB8, 0xAA, 0x87, 0x2C,
	0x54, 0x7C, 0xB9, 0xA3, 0xDE, 0xDF, 0xDF, 0xA3, 0xB1, 0x80, 0xF2, 0xC4, 0xCD, 0xC9, 0xF1, 0xB8,
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	0xC8, 0x9F, 0x12, 0x9E, 0xF3, 0x15, 0xA8, 0xDA, 0x12, 0x10, 0xD8, 0xF1, 0xAF, 0xC8, 0x97, 0x87,
	/* bank # 5 */
	0x34, 0xB5, 0xB9, 0x94, 0xA4, 0x21, 0xF3, 0xD9, 0x22, 0xD8, 0xF2, 0x2D, 0xF3, 0xD9, 0x2A, 0xD8,
	0xF2, 0x35, 0xF3, 0xD9, 0x32, 0xD8, 0x81, 0xA4, 0x60, 0x60, 0x61, 0xD9, 0x61, 0xD8, 0x6C, 0x68,
	0x69, 0xD9, 0x69, 0xD8, 0x74, 0x70, 0x71, 0xD9, 0x71, 0xD8, 0xB1, 0xA3, 0x84, 0x19, 0x3D, 0x5D,
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	0x8A, 0x64, 0x48, 0x31, 0x8B, 0x30, 0x49, 0x60, 0xA5, 0x88, 0x20, 0x09, 0x71, 0x58, 0x44, 0x68,
	/* bank # 6 */
	0x11, 0x39, 0x64, 0x49, 0x30, 0x19, 0xF1, 0xAC, 0x00, 0x2C, 0x54, 0x7C, 0xF0, 0x8C, 0xA8, 0x04,
	0x28, 0x50, 0x78, 0xF1, 0x88, 0x97, 0x26, 0xA8, 0x59, 0x98, 0xAC, 0x8C, 0x02, 0x26, 0x46, 0x66,
	0xF0, 0x89, 0x9C, 0xA8, 0x29, 0x51, 0x79, 0x24, 0x70, 0x59, 0x44, 0x69, 0x38, 0x64, 0x48, 0x31,
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	0xAC, 0x91, 0x2C, 0x4C, 0x6C, 0x8A, 0x9B, 0x2D, 0xD9, 0xD8, 0xD8, 0x51, 0xD9, 0xD8, 0xD8, 0x79,
	/* bank # 7 */
	0xD9, 0xD8, 0xD8, 0xF1, 0x9E, 0x88, 0xA3, 0x31, 0xDA, 0xD8, 0xD8, 0x91, 0x2D, 0xD9, 0x28, 0xD8,
	0x4D, 0xD9, 0x48, 0xD8, 0x6D, 0xD9, 0x68, 0xD8, 0xB1, 0x83, 0x93, 0x35, 0x3D, 0x80, 0x25, 0xDA,
	0xD8, 0xD8, 0x85, 0x69, 0xDA, 0xD8, 0xD8, 0xB4, 0x93, 0x81, 0xA3, 0x28, 0x34, 0x3C, 0xF3, 0xAB,
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	0xB9, 0xA7, 0xF1, 0x26, 0x26, 0x26, 0xFE, 0xD8, 0xFF,
 
};
 
uint8_t buffer[14];

uint8_t mpuIntStatus;
uint16_t dmpPacketSize;
uint8_t SaveAddress;
bool dmpReady = false;
uint16_t packetSize = 42;
volatile bool mpuInterrupt = false;     // indicates whether MPU interrupt pin has gone high
uint16_t fifoCount;
uint8_t fifoBuffer[64]; 
float q[4];//w,x,y,z
int16_t aa[3];//x,y,z
float aaReal[3]; //x,y,z
float gravity[3];//x,y,z
float euler[3];         // [psi, theta, phi]    Euler angle container
float pry[3];           // [yaw, pitch, roll]   yaw/pitch/roll container and gravity vector
 
/*=================================================================================================*/
 
/*                                      Utility functions                                          */
 
/*=================================================================================================*/
 
 
 
/*======================================I2C=============================================*/
 
 
 
void dmpDataReady() {
    mpuInterrupt = true;
}
 
void write_mpu(byte reg,byte data){
  I2C_BUS_0.beginTransmission(mpu_addr);
  I2C_BUS_0.write(reg);
  I2C_BUS_0.write(data);
  I2C_BUS_0.endTransmission();
}

int8_t readBytes(uint8_t devAddr, uint8_t regAddr, uint8_t length, uint8_t *data, uint16_t timeout, void *wireObj){
  int8_t count = 0;
  uint32_t t1 = millis();
  for (int k = 0; k < length; k += min((int)length, 128)) {
    I2C_BUS_0.beginTransmission(devAddr);
    I2C_BUS_0.write(regAddr);
    I2C_BUS_0.endTransmission();
    I2C_BUS_0.requestFrom((uint8_t)devAddr, (uint8_t)min((int)length - k, 128));
    for (;I2C_BUS_0.available() && (timeout == 0 || millis() - t1 < timeout); count++) {
      data[count] = I2C_BUS_0.read();
    }
  }
  if (timeout > 0 && millis() - t1 >= timeout && count < length) count = -1; // timeout
  return count;
}

int8_t readByte(uint8_t devAddr, uint8_t regAddr, uint8_t *data, uint16_t timeout, void *wireObj) {
    return readBytes(devAddr, regAddr, 1, data, timeout, wireObj);
}
 
int8_t readBit(uint8_t devAddr, uint8_t regAddr, uint8_t bitNum, uint8_t *data, uint16_t timeout, void *wireObj) {
    uint8_t b;
    uint8_t count = readByte(devAddr, regAddr, &b, timeout, wireObj);
    *data = b & (1 << bitNum);
    return count;
}
 
int8_t readBits(uint8_t devAddr, uint8_t regAddr, uint8_t bitStart, uint8_t length, uint8_t *data, uint16_t timeout, void *wireObj) {
    // 01101001 read byte
    // 76543210 bit numbers
    //    xxx   args: bitStart=4, length=3
    //    010   masked
    //   -> 010 shifted
    uint8_t count, b;
    if ((count = readByte(devAddr, regAddr, &b, timeout, wireObj)) != 0) {
        uint8_t mask = ((1 << length) - 1) << (bitStart - length + 1);
        b &= mask;
        b >>= (bitStart - length + 1);
        *data = b;
    }
    return count;
}
 
void writeBytes(uint8_t devAddr, uint8_t regAddr, uint8_t length, uint8_t* data, void *wireObj) {
    //writeBytes(devAddr, regAddr, 1, &data, wireObj);
    I2C_BUS_0.beginTransmission(devAddr);
    I2C_BUS_0.write((uint8_t) regAddr); // send address
    for (uint8_t i = 0; i < length; i++) {
      I2C_BUS_0.write((uint8_t) data[i]);
    }
    I2C_BUS_0.endTransmission();
}
 
void writeByte(uint8_t devAddr, uint8_t regAddr, uint8_t data, void *wireObj) {
    return writeBytes(devAddr, regAddr, 1, &data, wireObj);
}
 
void writeBits(uint8_t devAddr, uint8_t regAddr, uint8_t bitStart, uint8_t length, uint8_t data, void *wireObj){
  uint8_t b;
  uint8_t mask = ((1 << length) - 1) << (bitStart - length + 1);
  data <<= (bitStart - length + 1); // shift data into correct position
  data &= mask; // zero all non-important bits in data
  b &= ~(mask); // zero all important bits in existing byte
  b |= data; // combine data with existing byte
  writeByte(devAddr, regAddr, b, wireObj);
}
 
void writeBit(uint8_t devAddr, uint8_t regAddr, uint8_t bitNum, uint8_t data, void *wireObj) {
    uint8_t b;
    readByte(devAddr, regAddr, &b, 1000, wireObj);
    b = (data != 0) ? (b | (1 << bitNum)) : (b & ~(1 << bitNum));
    writeByte(devAddr, regAddr, b, wireObj);
}
 
void setMemoryBank(uint8_t bank, bool prefetchEnabled, bool userBank) {
    bank &= 0x1F;
    if (userBank) bank |= 0x20;
    if (prefetchEnabled) bank |= 0x40;
    writeByte(mpu_addr, MPU6050_RA_BANK_SEL, bank, 0);
}
 
bool writeMemoryBlock(const uint8_t *data, uint16_t dataSize, uint8_t bank, uint8_t address, bool verify, bool useProgMem) {
    setMemoryBank(bank,0,0);
    writeByte(mpu_addr, MPU6050_RA_MEM_START_ADDR, address, 0);
    uint8_t chunkSize;
    uint8_t *verifyBuffer=0;
    uint8_t *progBuffer=0;
    uint16_t i;
    uint8_t j;
    if (verify) verifyBuffer = (uint8_t *)malloc(MPU6050_DMP_MEMORY_CHUNK_SIZE);
    if (useProgMem) progBuffer = (uint8_t *)malloc(MPU6050_DMP_MEMORY_CHUNK_SIZE);
    for (i = 0; i < dataSize;) {
        // determine correct chunk size according to bank position and data size
        chunkSize = MPU6050_DMP_MEMORY_CHUNK_SIZE;
 
        // make sure we don't go past the data size
        if (i + chunkSize > dataSize) chunkSize = dataSize - i;
 
        // make sure this chunk doesn't go past the bank boundary (256 bytes)
        if (chunkSize > 256 - address) chunkSize = 256 - address;
        
        if (useProgMem) {
            // write the chunk of data as specified
            for (j = 0; j < chunkSize; j++) progBuffer[j] = pgm_read_byte(data + i + j);
        } else {
            // write the chunk of data as specified
            progBuffer = (uint8_t *)data + i;
        }
 
        writeBytes(mpu_addr, MPU6050_RA_MEM_R_W, chunkSize, progBuffer, 0);
 
        // verify data if needed
        if (verify && verifyBuffer) {
            setMemoryBank(bank,0,0);
            writeByte(mpu_addr, MPU6050_RA_MEM_START_ADDR, address, 0);
            readBytes(mpu_addr, MPU6050_RA_MEM_R_W, chunkSize, verifyBuffer, 1000, 0);
            if (memcmp(progBuffer, verifyBuffer, chunkSize) != 0) {
                free(verifyBuffer);
                if (useProgMem) free(progBuffer);
                return false; // uh oh.
            }
        }
 
        // increase byte index by [chunkSize]
        i += chunkSize;
 
        // uint8_t automatically wraps to 0 at 256
        address += chunkSize;
 
        // if we aren't done, update bank (if necessary) and address
        if (i < dataSize) {
            if (address == 0) bank++;
            setMemoryBank(bank,0,0);
            writeByte(mpu_addr, MPU6050_RA_MEM_START_ADDR, address, 0);
        }
    }
    if (verify) free(verifyBuffer);
    if (useProgMem) free(progBuffer);
    return true;
}
 
bool writeWords(uint8_t devAddr, uint8_t regAddr, uint8_t length, uint16_t* data, void *wireObj) {
    uint8_t status = 0;
    I2C_BUS_0.beginTransmission(devAddr);
    I2C_BUS_0.write(regAddr); // send address
    for (uint8_t i = 0; i < length; i++) { 
      I2C_BUS_0.write((uint8_t)(data[i] >> 8));    // send MSB
      I2C_BUS_0.write((uint8_t)data[i]);         // send LSB
    }
    status = I2C_BUS_0.endTransmission();
    return status == 0;
}
 
bool writeWord(uint8_t devAddr, uint8_t regAddr, uint16_t data, void *wireObj) {
    return writeWords(devAddr, regAddr, 1, &data, wireObj);
}
 
uint8_t getDeviceID() {
    readBits(mpu_addr, MPU6050_RA_WHO_AM_I, MPU6050_WHO_AM_I_BIT, MPU6050_WHO_AM_I_LENGTH, buffer, 1000, 0);
    return buffer[0];
}
 
uint8_t getIntStatus() {
    readByte(mpu_addr, MPU6050_RA_INT_STATUS, buffer, 1000, 0);
    return buffer[0];
}
 
uint16_t getFIFOCount() {
    readBytes(mpu_addr, MPU6050_RA_FIFO_COUNTH, 2, buffer, 1000, 0);
    return (((uint16_t)buffer[0]) << 8) | buffer[1];
}
 
void getFIFOBytes(uint8_t *data, uint8_t length) {
    if(length > 0){
        readBytes(mpu_addr, MPU6050_RA_FIFO_R_W, length, data, 1000, 0);
    } else {
    	*data = 0;
    }
}

/*===========================================Calculations===================================================*/
 
 
 
void getQuaternion(int16_t *data, const uint8_t* packet) {
    // TODO: accommodate different arrangements of sent data (ONLY default supported now)
    data[0] = ((packet[0] << 8) | packet[1]);
    data[1] = ((packet[4] << 8) | packet[5]);
    data[2] = ((packet[8] << 8) | packet[9]);
    data[3] = ((packet[12] << 8) | packet[13]);
}
 
void dmpGetQuaternion(float *q, const uint8_t* packet) {
    // TODO: accommodate different arrangements of sent data (ONLY default supported now)
    int16_t qI[4];
    getQuaternion(qI, packet);
    q[0] = (float)qI[0] / 16384.0f;
    q[1] = (float)qI[1] / 16384.0f;
    q[2] = (float)qI[2] / 16384.0f;
    q[3] = (float)qI[3] / 16384.0f;
}
 
void dmpGetGravity(float *v, float *q) {
  v[0] = 2 * (q[1]*q[3] - q[0]*q[2]);
  v[1] = 2 * (q[0]*q[1] + q[2]*q[3]);
  v[2] = q[0]*q[0] - q[1]*q[1] - q[2]*q[2] + q[3]*q[3];
}
 
void dmpGetPitchRollYaw(float *data, float *q, float *gravity) {
    // pitch: (nose up/down, about Y axis)
    data[0] = atan2(gravity[0] , sqrt(gravity[1]*gravity[1] + gravity[2]*gravity[2]));
    // roll: (tilt left/right, about X axis)
    data[1] = atan2(gravity[1] , gravity[2]);
    // yaw: (about Z axis)
    data[2] = atan2(2*q[1]*q[2] - 2*q[0]*q[3], 2*q[0]*q[0] + 2*q[1]*q[1] - 1);
    if (gravity[2] < 0) {
        if(data[1] > 0) {
            data[1] = PI - data[1]; 
        } else { 
            data[1] = -PI - data[1];
        }
    }
}
 
float map_(float x, float in_min, float in_max, float out_min, float out_max) {
    const float run = in_max - in_min;
    const float rise = out_max - out_min;
    const float delta = x - in_min;
    return (delta * rise) / run + out_min;
}
 
// calibrate "val" on your own!
int gravity_offset_table(float  val){
    if (val<0.05){
        return (int)map_(val,0,0.05,0,350);
    }else if(val<0.1){
        return (int)map_(val,0.05,0.1,350,760);
    }else if(val<0.15){
        return (int)map_(val,0.1,0.15,760,1080);
    }else if(val<0.2){
        return (int)map_(val,0.15,0.2,1080,1460);
    }else if(val<0.25){
        return (int)map_(val,0.2,0.25,1460,1850);
    }else if(val<0.3){
        return (int)map_(val,0.25,0.3,1850,2200);
    }else if(val<0.35){
        return (int)map_(val,0.3,0.35,2200,2550);
    }else if(val<0.4){
        return (int)map_(val,0.35,0.4,2550,2900);
    }else if(val<0.45){
        return (int)map_(val,0.4,0.45,2900,3270);
    }else if(val<0.5){
        return (int)map_(val,0.45,0.5,3270,3610);
    }else if(val<0.55){
        return (int)map_(val,0.5,0.55,3610,3990);
    }else if(val<0.6){
        return (int)map_(val,0.55,0.6,3990,4340);
    }else if(val<0.65){
        return (int)map_(val,0.6,0.65,4340,4710);
    }else if(val<0.7){
        return (int)map_(val,0.65,0.7,4710,5100);
    }else if(val<0.75){
        return (int)map_(val,0.7,0.75,5100,5480);
    }else if(val<0.8){
        return (int)map_(val,0.75,0.8,5480,5850);
    }else if(val<0.85){
        return (int)map_(val,0.8,0.85,5850,6210);
    }else if(val<0.9){
        return (int)map_(val,0.85,0.9,6210,6620);
    }else if(val<0.95){
        return (int)map_(val,0.9,0.95,6620,7100);
    }else{
        return (int)map_(val,0.95,1,7100,7610);
    }
}
 
int gravity_offset(float val){
    if(val>=0){
        return gravity_offset_table(val);
    }else{
        return -gravity_offset_table(-val);
    }
}
 
void dmpGetAccel(int16_t *v, const uint8_t* packet) {
    // TODO: accommodate different arrangements of sent data (ONLY default supported now)
    v[0] = (packet[28] << 8) | packet[29];
    v[1] = (packet[32] << 8) | packet[33];
    v[2] = (packet[36] << 8) | packet[37];
    v[2]+=1670;
}
 
void dmpGetLinearAccel(float *v, int16_t *vRaw, float *gravity) {
    v[0] = vRaw[0] - gravity_offset(gravity[0]);
    v[1] = vRaw[1] - gravity_offset(gravity[1]);
    v[2] = vRaw[2]-1675 - gravity[2]*6625;
    
}
 
void dmpGetEuler(float *pry, float *q) {
    pry[0] = -asin(2*q[1]*q[3] + 2*q[0]*q[2]);                              // theta
    pry[1] = atan2(2*q[2]*q[3] - 2*q[0]*q[1], 2*q[0]*q[0] + 2*q[3]*q[3] - 1);   // phi
    pry[2] = atan2(2*q[1]*q[2] - 2*q[0]*q[3], 2*q[0]*q[0] + 2*q[1]*q[1] - 1);   // psi
}
 
 
/*=====================================================Show===================================================*/
 


void show_gravity(){
    Serial.print("gravity:\t");
    Serial.print(gravity[0]);
    Serial.print("\t");
    Serial.print(gravity[1]);
    Serial.print("\t");
    Serial.println(gravity[2]);
}
 
void show_rotate(){
    Serial.print("PRY:\t");
    Serial.print(pry[0] * 180/M_PI);
    Serial.print("\t");
    Serial.print(pry[1] * 180/M_PI);
    Serial.print("\t");
    Serial.println(pry[2] * 180/M_PI);
}
 
void show_aa(){
    Serial.print("aa:\t");
    Serial.print(aa[0]);
    Serial.print("\t");
    Serial.print(aa[1]);
    Serial.print("\t");
    Serial.println(aa[2]);
}
 
void show_accel(){
    Serial.print("Accel:\t");
    Serial.print(aaReal[0]);
    Serial.print("\t");
    Serial.print(aaReal[1]);
    Serial.print("\t");
    Serial.println(aaReal[2]);
}
 
/*=================================================================================================*/
 
/*                                        Initialization                                           */
 
/*=================================================================================================*/
 
void initMPU6050(){
    write_mpu(0x1B,0x08);//设定陀螺仪量程+-500
    write_mpu(0x1C,0x00);//设定加速度计量程+-2g
    write_mpu(0x6B,0x01);//初始化mpu6050姿态传感器
 
    //initialize
    //writeBits(mpu_addr,0x6B,2,3,0x01,0);
    Serial.println("1");
    writeBits(mpu_addr, MPU6050_RA_PWR_MGMT_1, MPU6050_PWR1_CLKSEL_BIT, MPU6050_PWR1_CLKSEL_LENGTH, MPU6050_CLOCK_PLL_XGYRO, 0);
    //writeBits(mpu_addr,0x1B,4,2,0x00,0);
    Serial.println("2");
    writeBits(mpu_addr, MPU6050_RA_GYRO_CONFIG, MPU6050_GCONFIG_FS_SEL_BIT, MPU6050_GCONFIG_FS_SEL_LENGTH, MPU6050_GYRO_FS_250, 0);
    Serial.println("3");
    writeBits(mpu_addr, MPU6050_RA_ACCEL_CONFIG, MPU6050_ACONFIG_AFS_SEL_BIT, MPU6050_ACONFIG_AFS_SEL_LENGTH, MPU6050_ACCEL_FS_2, 0);
    Serial.println("4");
    writeBit(mpu_addr, MPU6050_RA_PWR_MGMT_1, MPU6050_PWR1_SLEEP_BIT, false,0);
    Serial.println("5");
    //initialize_end
 
    //dmpinitialize
    writeBit(mpu_addr, MPU6050_RA_PWR_MGMT_1, MPU6050_PWR1_DEVICE_RESET_BIT, true, 0);//reset
    writeBit(mpu_addr, MPU6050_RA_PWR_MGMT_1, MPU6050_PWR1_SLEEP_BIT, false, 0);
    setMemoryBank(0x10, true, true);
    writeByte(mpu_addr, MPU6050_RA_MEM_START_ADDR, 0x06, 0);
    readByte(mpu_addr, MPU6050_RA_MEM_R_W, buffer, 1000, 0);
    setMemoryBank(0, false, false);
    readBit(mpu_addr, MPU6050_RA_XG_OFFS_TC, MPU6050_TC_OTP_BNK_VLD_BIT, buffer, 1000, 0);
    writeByte(mpu_addr, MPU6050_RA_I2C_SLV0_ADDR, 0x7F, 0);
    writeBit(mpu_addr, MPU6050_RA_USER_CTRL, MPU6050_USERCTRL_I2C_MST_EN_BIT, false,0);
    writeByte(mpu_addr, MPU6050_RA_I2C_SLV0_ADDR, 0x68, 0);
    writeBit(mpu_addr, MPU6050_RA_USER_CTRL, MPU6050_USERCTRL_I2C_MST_RESET_BIT, true, 0);
    writeBits(mpu_addr, MPU6050_RA_PWR_MGMT_1, MPU6050_PWR1_CLKSEL_BIT, MPU6050_PWR1_CLKSEL_LENGTH, MPU6050_CLOCK_PLL_ZGYRO, 0);
    writeByte(mpu_addr, MPU6050_RA_INT_ENABLE, (1<<MPU6050_INTERRUPT_FIFO_OFLOW_BIT|1<<MPU6050_INTERRUPT_DMP_INT_BIT), 0);
    writeByte(mpu_addr, MPU6050_RA_SMPLRT_DIV, 4,0);
    writeBits(mpu_addr, MPU6050_RA_CONFIG, MPU6050_CFG_EXT_SYNC_SET_BIT, MPU6050_CFG_EXT_SYNC_SET_LENGTH, MPU6050_EXT_SYNC_TEMP_OUT_L, 0);
    writeBits(mpu_addr, MPU6050_RA_CONFIG, MPU6050_CFG_DLPF_CFG_BIT, MPU6050_CFG_DLPF_CFG_LENGTH, MPU6050_DLPF_BW_42, 0);
    writeBits(mpu_addr, MPU6050_RA_GYRO_CONFIG, MPU6050_GCONFIG_FS_SEL_BIT, MPU6050_GCONFIG_FS_SEL_LENGTH, MPU6050_GYRO_FS_2000, 0);
    //writeMemoryBlock(dmpMemory, MPU6050_DMP_CODE_SIZE, 0, 0, 0, true);
    if (!writeMemoryBlock(dmpMemory, MPU6050_DMP_CODE_SIZE, 0, 0, 0, true)){
        Serial.println("no");
        delay(1000);
    }
    unsigned char dmpUpdate[] = {0x00, MPU6050_DMP_FIFO_RATE_DIVISOR};
    writeMemoryBlock(dmpUpdate, 0x02, 0x02, 0x16,0,0);
    writeByte(mpu_addr, MPU6050_RA_DMP_CFG_1, 0x03, 0);
    writeByte(mpu_addr, MPU6050_RA_DMP_CFG_2, 0x00, 0);
    writeBit(mpu_addr, MPU6050_RA_XG_OFFS_TC, MPU6050_TC_OTP_BNK_VLD_BIT, false, 0);
    writeByte(mpu_addr, MPU6050_RA_MOT_THR, 2, 0);
    writeByte(mpu_addr, MPU6050_RA_ZRMOT_THR, 156, 0);
    writeByte(mpu_addr, MPU6050_RA_MOT_DUR, 80, 0);
    writeByte(mpu_addr, MPU6050_RA_ZRMOT_DUR, 0, 0);
    writeBit(mpu_addr, MPU6050_RA_USER_CTRL, MPU6050_USERCTRL_FIFO_EN_BIT, true, 0);
    writeBit(mpu_addr, MPU6050_RA_USER_CTRL, MPU6050_USERCTRL_DMP_RESET_BIT, true, 0);
    writeBit(mpu_addr, MPU6050_RA_USER_CTRL, MPU6050_USERCTRL_DMP_EN_BIT, false, 0);
    writeBit(mpu_addr, MPU6050_RA_USER_CTRL, MPU6050_USERCTRL_FIFO_RESET_BIT, true, 0);
    readByte(mpu_addr, MPU6050_RA_INT_STATUS, buffer, 1000, 0);
 
    writeWord(mpu_addr, MPU6050_RA_XG_OFFS_USRH, 220, 0);
    writeWord(mpu_addr, MPU6050_RA_YG_OFFS_USRH, 76, 0);
    writeWord(mpu_addr, MPU6050_RA_ZG_OFFS_USRH, 85, 0);
    SaveAddress = ((getDeviceID() < 0x38 )? MPU6050_RA_ZA_OFFS_H:0x7D);
    writeWord(mpu_addr, SaveAddress, 1788, 0);
 
    Serial.println(F("Enabling DMP..."));
    writeBit(mpu_addr, MPU6050_RA_USER_CTRL, MPU6050_USERCTRL_DMP_EN_BIT, true,0);
 
    // enable Arduino interrupt detection
    Serial.println(F("Enabling interrupt detection (Arduino external interrupt 0)..."));
    attachInterrupt(0, dmpDataReady, RISING);
    mpuIntStatus=getIntStatus();
 
    // set our DMP Ready flag so the main loop() function knows it's okay to use it
    Serial.println(F("DMP ready! Waiting for first interrupt..."));
    dmpReady = true;
 
    // get expected DMP packet size for later comparison
    packetSize = 42;
 
}
 
/*=================================================================================================*/
 
/*                                            运行                                                 */
 
/*=================================================================================================*/
 
void testMPU6050(){
    mpuInterrupt = false;
    mpuIntStatus = getIntStatus();
    fifoCount = getFIFOCount();
 
if ((mpuIntStatus & 0x10) || fifoCount == 1024) {
    // reset so we can continue cleanly
    writeBit(mpu_addr, MPU6050_RA_USER_CTRL, MPU6050_USERCTRL_FIFO_RESET_BIT, true, 0);
    Serial.println(F("FIFO overflow!"));

    // otherwise, check for DMP data ready interrupt (this should happen frequently)
} else if (mpuIntStatus & 0x02) {
    // wait for correct available data length, should be a VERY short wait
    while (fifoCount < packetSize) fifoCount = getFIFOCount();
 
    // read a packet from FIFO
    getFIFOBytes(fifoBuffer, packetSize);
    fifoCount -= packetSize;
 
    dmpGetQuaternion(q, fifoBuffer);
    dmpGetGravity(gravity, q);
    //dmpGetEuler(pry, q);//欧拉角计算（就是算法不同，输出结果和dmpGetGravity()等价）
    
 
    dmpGetPitchRollYaw(pry, q, gravity);//获取Pith，Roll，Yaw
    dmpGetAccel(aa, fifoBuffer);
    dmpGetLinearAccel(aaReal, aa, gravity);//获取实时加速度

    //show_gravity();//显示重力向量
    show_rotate();//显示旋转角度（Pitch，Roll，Yaw）
    //show_aa();//显示原始加速度数据（若不对平动加速度程序进行调试可以忽略）
    //show_accel();//显示平动加速度
  }
}